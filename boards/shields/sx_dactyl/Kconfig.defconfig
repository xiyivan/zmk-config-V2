## boards/shields/sx_dactyl/Kconfig.defconfig
```kconfig
if SHIELD_SX_DACTYL_LEFT

config ZMK_KEYBOARD_NAME
    default "sx_dactyl"

config ZMK_SPLIT_ROLE_CENTRAL
    default y

endif

if SHIELD_SX_DACTYL_LEFT || SHIELD_SX_DACTYL_RIGHT

config ZMK_SPLIT
    default y

endif
```

## boards/shields/sx_dactyl/Kconfig.shield
```kconfig
config SHIELD_SX_DACTYL_LEFT
    def_bool $(shields_list_contains,sx_dactyl_left)

config SHIELD_SX_DACTYL_RIGHT
    def_bool $(shields_list_contains,sx_dactyl_right)
```
